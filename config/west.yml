## config/west.yml
```yaml
manifest:
  remotes:
    - name: zmkfirmware
      url-base: https://github.com/zmkfirmware
    - name: inorichi
      url-base: https://github.com/inorichi
    - name: caksoylar
      url-base: https://github.com/caksoylar
    - name: badjeff
      url-base: https://github.com/badjeff
    - name: ssbb
      url-base: https://github.com/ssbb
    - name: 4mplelab
      url-base: https://github.com/4mplelab
    - name: kot149
      url-base: https://github.com/kot149
    - name: t-ogura
      url-base: https://github.com/t-ogura
    - name: cormoran
      url-base: https://github.com/cormoran
  projects:
    # # https://github.com/zmkfirmware/zmk
    # - name: zmk
    #   remote: zmkfirmware
    #   revision: main
    #   import: app/west.yml

    - name: zmk
      remote: cormoran
      revision: main+dya
      import:
        file: app/west.yml

    # # https://github.com/inorichi/zmk-pmw3610-driver
    # - name: zmk-pmw3610-driver
    #   remote: inorichi
    #   revision: main
    #   path: modules/zmk-pmw3610-driver

    # https://github.com/badjeff/zmk-pmw3610-driver
    - name: zmk-pmw3610-driver
      remote: badjeff
      revision: zmk-0.4
      path: modules/zmk-pmw3610-driver-badjeff

    # https://github.com/badjeff/zmk-input-processor-report-rate-limit
    - name: zmk-input-processor-report-rate-limit
      remote: badjeff
      revision: main
      path: modules/zmk-input-processor-report-rate-limit

    # https://github.com/ssbb/zmk-listeners
    - name: zmk-listeners
      remote: ssbb
      revision: v1
      path: modules/zmk-listeners

    # https://github.com/caksoylar/zmk-rgbled-widget
    - name: zmk-rgbled-widget
      remote: caksoylar
      revision: main
      path: modules/zmk-rgbled-widget

    # https://github.com/4mplelab/zmk-feature-charge-indicator.git
    - name: zmk-feature-charge-indicator
      remote: 4mplelab
      revision: main
      path: modules/zmk-feature-charge-indicator

    # https://github.com/kot149/zmk-mouse-gesture
    - name: zmk-mouse-gesture
      remote: kot149
      revision: v1
      path: modules/zmk-mouse-gesture

    # https://github.com/kot149/zmk-layout-shift
    - name: zmk-layout-shift
      remote: kot149
      revision: v1
      path: modules/zmk-layout-shift

    # https://github.com/kot149/zmk-scroll-snap
    - name: zmk-scroll-snap
      remote: kot149
      revision: v1
      path: modules/zmk-scroll-snap

    # https://github.com/t-ogura/prospector-zmk-module
    - name: prospector-zmk-module
      remote: t-ogura
      revision: feature/v2.1.0-touch-mode
      path: modules/prospector-scanner-zmk-module

    - name: zephyr
      remote: cormoran
      revision: v4.1.0+zmk-fixes+nrf-half-duplex-uart
      clone-depth: 1
      import:
        name-blocklist:
          - ci-tools
          - hal_altera
          - hal_cypress
          - hal_infineon
          - hal_microchip
          - hal_nxp
          - hal_openisa
          - hal_xtensa
          - hal_st
          - hal_ti
          - loramac-node
          - mcuboot
          - mcumgr
          - net-tools
          - openthread
          - edtt
          - trusted-firmware-m

    - name: zmk-feature-custom-settings
      remote: cormoran
      revision: main
    - name: zmk-feature-fast-keymap
      remote: cormoran
      revision: main
    - name: zmk-feature-runtime-macro
      remote: cormoran
      revision: main
    - name: zmk-feature-runtime-combo
      remote: cormoran
      revision: main
    - name: zmk-feature-input-stream # 押下キー表示が必要な場合だけ
      remote: cormoran
      revision: main
    - name: zmk-feature-module-physical-layout # プレビューに拡張モジュールを表示する場合だけ
      remote: cormoran
      revision: main
    - name: zmk-driver-pmw3610-with-custom-studio-rpc
      remote: cormoran
      revision: main
    - name: zmk-module-runtime-input-processor
      remote: cormoran
      revision: main
    - name: zmk-module-ble-management
      remote: cormoran
      revision: main
    - name: zmk-feature-default-layer
      remote: cormoran
      revision: codex/custom-rpc-rewrite
    - name: zmk-feature-os-detection
      remote: cormoran
      revision: main
    - name: zmk-module-settings-rpc
      remote: cormoran
      revision: main
    - name: zmk-behavior-runtime-sensor-rotate
      remote: cormoran
      revision: main

  self:
    path: config
```
